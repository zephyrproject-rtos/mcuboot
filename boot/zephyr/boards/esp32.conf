## boot/zephyr/boards/esp32.conf
```kconfig
# SPDX-FileCopyrightText: 2021 Espressif Systems (Shanghai) CO LTD
# SPDX-License-Identifier: Apache-2.0

CONFIG_BOOT_MAX_IMG_SECTORS=512

CONFIG_BOOT_UPGRADE_ONLY=y

CONFIG_BOOT_VALIDATE_SLOT0=n

CONFIG_LOG=n

CONFIG_BOOT_BANNER=n

#CONFIG_SINGLE_APPLICATION_SLOT=y

# Experimenting
#CONFIG_MULTITHREADING=n
#CONFIG_ARCH_HAS_SINGLE_THREAD_SUPPORT=y

#CONFIG_BOOT_SIGNATURE_TYPE_NONE=y

#CONFIG_FLASH_LOG_LEVEL_DBG=y
#
## Enables the MCUboot Serial Recovery, that allows the use of
## MCUMGR to upload a firmware through the serial port
## CONFIG_ESP_MCUBOOT_SERIAL=y
## Use sector erasing instead of entire image size erasing
## when uploading through Serial Recovery
## CONFIG_ESP_MCUBOOT_ERASE_PROGRESSIVELY=y
## GPIO used to boot on Serial Recovery
## CONFIG_ESP_SERIAL_BOOT_GPIO_DETECT=32
## GPIO input type (0 for Pull-down, 1 for Pull-up)
## CONFIG_ESP_SERIAL_BOOT_GPIO_INPUT_TYPE=0
## GPIO signal value
## CONFIG_ESP_SERIAL_BOOT_GPIO_DETECT_VAL=1
## Delay time for identify the GPIO signal
## CONFIG_ESP_SERIAL_BOOT_DETECT_DELAY_S=5
## UART port used for serial communication
## CONFIG_ESP_SERIAL_BOOT_UART_NUM=1
## GPIO for Serial RX signal
## CONFIG_ESP_SERIAL_BOOT_GPIO_RX=25
## GPIO for Serial TX signal
## CONFIG_ESP_SERIAL_BOOT_GPIO_TX=26
#
## Enables multi image, if it is not defined, it is assumed
## only one updatable image
## CONFIG_ESP_IMAGE_NUMBER=2
#
## Enables multi image boot on independent processors
## (main host OS is not responsible for booting the second image)
## Use only with CONFIG_ESP_IMAGE_NUMBER=2
## CONFIG_ESP_MULTI_PROCESSOR_BOOT=y
#
#
## CONFIG_ESP_SIGN_EC256=y
## CONFIG_ESP_SIGN_ED25519=n
## CONFIG_ESP_SIGN_RSA=n
## CONFIG_ESP_SIGN_RSA_LEN=2048
#
## Use Tinycrypt lib for EC256 or ED25519 signing
## CONFIG_ESP_USE_TINYCRYPT=y
## Use Mbed TLS lib for RSA image signing
## CONFIG_ESP_USE_MBEDTLS=n
#
## It is strongly recommended to generate a new signing key
## using imgtool instead of use the existent sample
## CONFIG_ESP_SIGN_KEY_FILE=root-ec-p256.pem
#
## Hardware Secure Boot related options
## CONFIG_SECURE_SIGNED_ON_BOOT=1
## CONFIG_SECURE_SIGNED_APPS_RSA_SCHEME=1
## CONFIG_SECURE_BOOT=1
## CONFIG_SECURE_BOOT_V2_ENABLED=1
## CONFIG_SECURE_BOOT_SUPPORTS_RSA=1
#
## Hardware Flash Encryption related options
## CONFIG_SECURE_FLASH_ENC_ENABLED=1
## CONFIG_SECURE_FLASH_UART_BOOTLOADER_ALLOW_ENC=1
## CONFIG_SECURE_FLASH_UART_BOOTLOADER_ALLOW_DEC=1
## CONFIG_SECURE_FLASH_UART_BOOTLOADER_ALLOW_CACHE=1
## CONFIG_SECURE_FLASH_ENCRYPTION_MODE_DEVELOPMENT=1
## CONFIG_SECURE_BOOT_ALLOW_JTAG=1
## CONFIG_SECURE_BOOT_ALLOW_ROM_BASIC=1
#
## Options for enabling eFuse emulation in Flash
## CONFIG_EFUSE_VIRTUAL=1
## CONFIG_EFUSE_VIRTUAL_KEEP_IN_FLASH=1
```

## boot/zephyr/boards/xtensa/neq_hvaciot_esp32s3/Kconfig.board
```kconfig
# NEQ HVAC IoT ESP32S3 board configuration

# Copyright (c) 2023 NEQ
# SPDX-License-Identifier: Apache-2.0

config BOARD_NEQ_HVACIOT_ESP32S3
	bool "NEQ ESP32-S3 HVAC IoT Board"
	depends on SOC_SERIES_ESP32S3
```

## boot/zephyr/boards/xtensa/neq_hvaciot_esp32s3/Kconfig.defconfig
```kconfig
# NEQ HVAC IoT ESP32S3 board configuration

# Copyright (c) 2023 NEQ
# SPDX-License-Identifier: Apache-2.0

if BOARD_NEQ_HVACIOT_ESP32S3

config BOARD
	default "neq_hvaciot_esp32s3"

config ENTROPY_GENERATOR
	default y

config HEAP_MEM_POOL_SIZE
	default 98304 if WIFI
	default 40960 if BT
	default 4096

choice BT_HCI_BUS_TYPE
	default BT_ESP32 if BT
endchoice

endif # BOARD_NEQ_HVACIOT_ESP32S3
```

## boot/zephyr/boards/xtensa/neq_hvaciot_esp32s3/neq_hvaciot_esp32s3_defconfig
```kconfig
# SPDX-License-Identifier: Apache-2.0

CONFIG_BOARD_NEQ_HVACIOT_ESP32S3=y
CONFIG_SOC_SERIES_ESP32S3=y
CONFIG_SOC_ESP32S3_WROOM_N4R2=y

CONFIG_MAIN_STACK_SIZE=2048

CONFIG_CONSOLE=y
CONFIG_SERIAL=y
CONFIG_UART_CONSOLE=y
CONFIG_GPIO=y
CONFIG_CLOCK_CONTROL=y
```
